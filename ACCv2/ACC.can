/*@!Encoding:1252*/
variables {
  
  // Messages sent from component
  message ACC_Brake acc_brake;
  message ACC_Accelerate acc_accelerate;
  message ACC_Slowdown acc_slowdown;
  message ACC_Error acc_error;
  
  //message ACC_State acc_state;
  message Display_State display_state;
  
  // State of Adaptive Cruise Control
  byte acc = 0;
  byte speed;
  byte distance;
  
  // State of cars
  byte lane_car1_current;
  byte lane_car2_current;
  int  speed_car1_current;
  int  speed_car2_current;
  long distance_current;
  
  // Max Values and Parameters
  byte Min_Distance = 10;
  byte Max_Distance = 30;
  int Max_Speed = 180;
  int Min_Speed = 30;
  int Off_Speed = 25;
  double criticalDistanceFactor = 0.3;
  
  // Timer for updating display
  msTimer timer_display;
  const byte TIMEOUT_DISPLAY = 10;
  // Timer for sending Accelerate Messages
  msTimer timer_accelerate;
  const byte TIMEOUT_ACCELERATE = 10;
  // Timer for sending Slowdown Messages
  msTimer timer_slowdown;
  const byte TIMEOUT_SLOWDOWN = 10;
  // Timer for sending Brake Messages
  msTimer timer_brake;
  const byte TIMEOUT_BRAKE = 5;
  
}

// Initialize component
on start {
  setTimer(timer_display, TIMEOUT_DISPLAY);
  sendSettings();
}

// Send periodically updates to display
on timer timer_display {
  setTimer(timer_display, TIMEOUT_DISPLAY);
  sendSettings();
}

// Adjust Distance to request sent from display
on message Distance_Adjust {
  if(acc==1) {
    if(this.Distance_Adjust >= Min_Distance && this.Distance_Adjust <= Max_Distance) {
     distance =  this.Distance_Adjust;
    } 
  }
}

// Adjust Speed from request sent from display
on message Speed_Adjust {
  if(acc == 1) {
    if(this.Speed_Adjust >= Min_Speed && this.Speed_Adjust <= Max_Speed) {
      speed = this.Speed_Adjust;
    } 
  }
}

// Turn on ACC and adjust values if neccessary
on message ACC_State {
  if(speed_car1_current > Off_Speed && speed_car1_current < Max_Speed) {
    acc = this.ACC_State;
    if(acc == 1) {
      initAcc(); 
    } 
  }
}

// React on driver breaking manually
on message Manual_Brake {
  acc = 0;
}

// React on driver accelerating manually
on message Manual_Accelerate {
  acc = 0;
}

// Update State of car we control
on message Car1_State {
  speed_car1_current = this.Speed_Car1_Current;
  if(this.Speed_Car1_Current < Off_Speed)
  {
    acc = 0;
    acc_error.ACC_Error = 1;
    output(acc_error);
  } else {
    lane_car1_current = this.Lane_Car1_Current;    
  }
}

// Update State of other car
on message Car2_State {
  speed_car2_current = this.Speed_Car2_Current;
  lane_car2_current = this.Lane_Car2_Current;
}

// Update on Distance between both cars and handle
on message Distance_Current {
  distance_current = this.Distance_Current;
  if(ACCisOn()) {
      if(getCurrentDistanceInSec() <= ((double)distance)) {
        // Distance to car in front is too short
        if(lane_car1_current == lane_car2_current) {
          if(situationCritical() == 1) {
            manageBrake();
          } else {
            manageSlowdown();
          }
        }
      } else if(speed_car1_current > speed) {
        // Car is faster than ACC speed
        manageSlowdown();
      } else if(speed_car1_current < speed) {
        // Car is slower than ACC speed
        manageAccelerate();
      }
    }
}

// ======================= Send messages =======================

manageAccelerate() {
  if(!isTimerActive(timer_accelerate)) {
    setTimer(timer_accelerate, TIMEOUT_ACCELERATE);
  }
}

manageBrake() {
  if(!isTimerActive(timer_brake)) {
    setTimer(timer_brake, TIMEOUT_BRAKE);
  }
}

manageSlowdown() {
  if(!isTimerActive(timer_slowdown)) {
    setTimer(timer_slowdown,TIMEOUT_SLOWDOWN);
  }
}

on timer timer_accelerate {
  sendACCAccelerate(); 
}

on timer timer_brake {
  sendACCBrake(); 
}

on timer timer_slowdown {
  sendACCSlowdown();
}

sendACCAccelerate() {
  acc_accelerate.PedalTravel_ACC_Accelerate = 1;
  output(acc_accelerate);
}

sendACCBrake() {
  acc_brake.PedalTravel_ACC_Brake = 1;
  output(acc_brake);
}

sendACCSlowdown() {
  acc_slowdown.PedalTravel_ACC_Slowdown = 1;
  output(acc_slowdown);
}

sendSettings() {
  display_state.ACC_State = acc;
  display_state.Speed_Adjusted = speed;
  display_state.Distance_Adjusted = distance;
  
  output(display_state);
}

// ==================== Utilities ====================

// Set Distance to valid value and speed to current speed of Car 1
initAcc() {
  if(distance < Min_Distance || distance > Max_Distance) {
    // Mid between the distances max and min value
    distance = (Min_Distance + ((Max_Distance - Min_Distance) / 2));  
  }
  if(speed_car1_current > Min_Speed && speed_car1_current < Max_Speed) {
    // Set desired speed to current speed of car 1
    speed = speed_car1_current;
  }
}

byte ACCisOn() {
  return acc;
}

// Converts current distance in m into sec depending on current speed
double getCurrentDistanceInSec() {
   return(((double)distance_current/10)/getCurrentSpeedInMperS());
}

// Convert Speed in Meters per Second 
double getCurrentSpeedInMperS() {
  return ((double)speed_car1_current/3.6);
}

// Boundary, when the car should brake instead of slowdown
double getCriticalDistanceInSec() {
  return criticalDistanceFactor * (double)distance;
}

// situation is critical, if the actual distance is smaller
// or equal compared to the ciritical distance
byte situationCritical() {
  if(getCurrentDistanceInSec() <= getCriticalDistanceInSec()) {
    return 1;
  } else {
    return 0; 
  }
}
